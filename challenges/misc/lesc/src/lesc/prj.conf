## CMakeLists.txt
```
cmake_minimum_required(VERSION 3.20.0)
find_package(Zephyr REQUIRED HINTS $ENV{ZEPHYR_BASE})

project(lesc)

target_sources(app PRIVATE
    src/main.c
    src/flag_store_service.c
)
```

## prj.conf
```kconfig
CONFIG_BT=y
CONFIG_BT_SMP=y
CONFIG_BT_SIGNING=y
CONFIG_BT_PERIPHERAL=y
CONFIG_BT_ATT_PREPARE_COUNT=5
CONFIG_BT_PRIVACY=n
CONFIG_BT_DEVICE_NAME="FlagStore"
CONFIG_BT_L2CAP_TX_MTU=251
CONFIG_BT_USER_DATA_LEN_UPDATE=y
CONFIG_HEAP_MEM_POOL_SIZE=8148
CONFIG_BT_GATT_DYNAMIC_DB=y

# Enable settings for storing BLE keys
CONFIG_BT_KEYS_OVERWRITE_OLDEST=y
CONFIG_BT_SETTINGS=y
CONFIG_FLASH=y
CONFIG_FLASH_PAGE_LAYOUT=y
CONFIG_FLASH_MAP=y
CONFIG_NVS=y
CONFIG_SETTINGS=y
CONFIG_BT_SMP_SC_ONLY=y
CONFIG_BT_MAX_PAIRED=20

CONFIG_LOG=y
```

## src/main.c
```c
#include <zephyr/kernel.h>

#include <zephyr/bluetooth/bluetooth.h>
#include <zephyr/bluetooth/hci.h>
#include <zephyr/bluetooth/uuid.h>
#include <zephyr/bluetooth/gatt.h>
#include <zephyr/bluetooth/services/bas.h>

#include <zephyr/settings/settings.h>

#include <zephyr/logging/log.h>

LOG_MODULE_REGISTER(MAIN, LOG_LEVEL_DBG);

static const struct bt_data ad[] = { BT_DATA_BYTES(BT_DATA_FLAGS, (BT_LE_AD_GENERAL | BT_LE_AD_NO_BREDR)), BT_DATA(BT_DATA_NAME_COMPLETE, CONFIG_BT_DEVICE_NAME, sizeof(CONFIG_BT_DEVICE_NAME))};

static void connected(struct bt_conn* conn, uint8_t err)
{
    if (err)
    {
        LOG_INF("Connection failed (err 0x%02x)", err);
    }
    else
    {
        LOG_INF("Connected");
    }
}

static void disconnected(struct bt_conn* conn, uint8_t reason)
{
    LOG_INF("Disconnected (reason 0x%02x)", reason);
}

static void security_changed(struct bt_conn* conn, bt_security_t level, enum bt_security_err err)
{
    char addr[BT_ADDR_LE_STR_LEN];

    bt_addr_le_to_str(bt_conn_get_dst(conn), addr, sizeof(addr));

    if (!err)
    {
        LOG_INF("Security changed: %s level %u\n", addr, level);
    }
    else
    {
        LOG_ERR("Security failed: %s level %u err %d\n", addr, level, err);
    }
}


BT_CONN_CB_DEFINE(conn_callbacks) = { .connected = connected, .disconnected = disconnected, .security_changed = security_changed };

static void auth_passkey_display(struct bt_conn* conn, unsigned int passkey)
{
    char addr[BT_ADDR_LE_STR_LEN];

    bt_addr_le_to_str(bt_conn_get_dst(conn), addr, sizeof(addr));

    LOG_INF("Passkey for %s: %06u", addr, passkey);
}

static void auth_cancel(struct bt_conn* conn)
{
    char addr[BT_ADDR_LE_STR_LEN];

    bt_addr_le_to_str(bt_conn_get_dst(conn), addr, sizeof(addr));

    LOG_INF("Pairing cancelled: %s", addr);
}


static struct bt_conn_auth_cb auth_cb_display = {
    .passkey_display = auth_passkey_display,
    .passkey_entry = NULL,
    .cancel = auth_cancel,
};

int main(void)
{
    LOG_INF("Loaded flag as %s", (const char*)(0x35d8));

    int err = bt_enable(NULL);
    if (err)
    {
        LOG_ERR("Failed to enable Bluetooth: %d", err);
        return err;
    }

    if (IS_ENABLED(CONFIG_SETTINGS))
    {
        settings_load();
    }

    err = bt_le_adv_start(BT_LE_ADV_CONN, ad, ARRAY_SIZE(ad), NULL, 0);
    if (err)
    {
        LOG_ERR("Failed to start advertising: %d", err);
        return err;
    }

    err = bt_conn_auth_cb_register(&auth_cb_display);
    if (err)
    {
        LOG_ERR("Failed to register auth callbacks: %d", err);
        return err;
    }

    

    LOG_INF("Started Bluetooth advertising");

}
```

## src/flag_store_service.c
```c
#include <zephyr/bluetooth/uuid.h>
#include <zephyr/bluetooth/gatt.h>
#include <stddef.h>
#include <string.h>
#include <zephyr/drivers/flash.h>
#include <zephyr/device.h>
#include <zephyr/devicetree.h>

#include <zephyr/logging/log.h>

LOG_MODULE_REGISTER(FLAG, LOG_LEVEL_DBG);

static struct bt_uuid_128 flag_store_service_uuid = BT_UUID_INIT_128(0x8d, 0xc9, 0x65, 0x16, 0x53, 0xe7, 0x72, 0x93, 0x5, 0x2a, 0x17, 0x24, 0x00, 0x14, 0x00, 0x00);
static struct bt_uuid_128 flag_characteristic_uuid = BT_UUID_INIT_128(0x8d, 0xc9, 0x65, 0x16, 0x53, 0xe7, 0x72, 0x93, 0x5, 0x2a, 0x17, 0x24, 0x01, 0x14, 0x00, 0x00);

static ssize_t flag_read(struct bt_conn* conn, const struct bt_gatt_attr* attr, void* buf, uint16_t len, uint16_t offset);

// Flag is stored in main core
const char* flag = (const char*)(0x35d8);


BT_GATT_SERVICE_DEFINE(flag_store_service, BT_GATT_PRIMARY_SERVICE(&flag_store_service_uuid),
                       BT_GATT_CHARACTERISTIC(&flag_characteristic_uuid.uuid, BT_GATT_CHRC_READ, BT_GATT_PERM_READ_AUTHEN | BT_GATT_PERM_READ_LESC, flag_read, NULL, NULL)
);

static ssize_t flag_read(struct bt_conn* conn, const struct bt_gatt_attr* attr, void* buf, uint16_t len, uint16_t offset)
{
    return bt_gatt_attr_read(conn, attr, buf, len, offset, flag, strlen(flag));
}
```
