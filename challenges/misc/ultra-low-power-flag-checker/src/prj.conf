## CMakeLists.txt
```
cmake_minimum_required(VERSION 3.20.0)
find_package(Zephyr REQUIRED HINTS $ENV{ZEPHYR_BASE})

project(src)

target_sources(app PRIVATE
    src/main.c
    libtommath/mp_2expt.c
    libtommath/mp_abs.c
    libtommath/mp_add.c
    libtommath/mp_add_d.c
    libtommath/mp_addmod.c
    libtommath/mp_and.c
    libtommath/mp_clamp.c
    libtommath/mp_clear.c
    libtommath/mp_clear_multi.c
    libtommath/mp_cmp.c
    libtommath/mp_cmp_d.c
    libtommath/mp_cmp_mag.c
    libtommath/mp_cnt_lsb.c
    libtommath/mp_complement.c
    libtommath/mp_copy.c
    libtommath/mp_count_bits.c
    libtommath/mp_cutoffs.c
    libtommath/mp_div.c
    libtommath/mp_div_2.c
    libtommath/mp_div_2d.c
    libtommath/mp_div_d.c
    libtommath/mp_dr_is_modulus.c
    libtommath/mp_dr_reduce.c
    libtommath/mp_dr_setup.c
    libtommath/mp_error_to_string.c
    libtommath/mp_exch.c
    libtommath/mp_expt_n.c
    libtommath/mp_exptmod.c
    libtommath/mp_exteuclid.c
    libtommath/mp_fread.c
    libtommath/mp_from_sbin.c
    libtommath/mp_from_ubin.c
    libtommath/mp_fwrite.c
    libtommath/mp_gcd.c
    libtommath/mp_get_double.c
    libtommath/mp_get_i32.c
    libtommath/mp_get_i64.c
    libtommath/mp_get_l.c
    libtommath/mp_get_mag_u32.c
    libtommath/mp_get_mag_u64.c
    libtommath/mp_get_mag_ul.c
    libtommath/mp_grow.c
    libtommath/mp_hash.c
    libtommath/mp_init.c
    libtommath/mp_init_copy.c
    libtommath/mp_init_i32.c
    libtommath/mp_init_i64.c
    libtommath/mp_init_l.c
    libtommath/mp_init_multi.c
    libtommath/mp_init_set.c
    libtommath/mp_init_size.c
    libtommath/mp_init_u32.c
    libtommath/mp_init_u64.c
    libtommath/mp_init_ul.c
    libtommath/mp_invmod.c
    libtommath/mp_is_square.c
    libtommath/mp_kronecker.c
    libtommath/mp_lcm.c
    libtommath/mp_log.c
    libtommath/mp_log_n.c
    libtommath/mp_lshd.c
    libtommath/mp_mod.c
    libtommath/mp_mod_2d.c
    libtommath/mp_montgomery_calc_normalization.c
    libtommath/mp_montgomery_reduce.c
    libtommath/mp_montgomery_setup.c
    libtommath/mp_mul.c
    libtommath/mp_mul_2.c
    libtommath/mp_mul_2d.c
    libtommath/mp_mul_d.c
    libtommath/mp_mulmod.c
    libtommath/mp_neg.c
    libtommath/mp_or.c
    libtommath/mp_pack.c
    libtommath/mp_pack_count.c
    libtommath/mp_prime_fermat.c
    libtommath/mp_prime_frobenius_underwood.c
    libtommath/mp_prime_is_prime.c
    libtommath/mp_prime_miller_rabin.c
    libtommath/mp_prime_next_prime.c
    libtommath/mp_prime_rabin_miller_trials.c
    libtommath/mp_prime_rand.c
    libtommath/mp_prime_strong_lucas_selfridge.c
    libtommath/mp_radix_size.c
    libtommath/mp_radix_size_overestimate.c
    libtommath/mp_rand.c
    libtommath/mp_rand_source.c
    libtommath/mp_read_radix.c
    libtommath/mp_reduce.c
    libtommath/mp_reduce_2k.c
    libtommath/mp_reduce_2k_l.c
    libtommath/mp_reduce_2k_setup.c
    libtommath/mp_reduce_2k_setup_l.c
    libtommath/mp_reduce_is_2k.c
    libtommath/mp_reduce_is_2k_l.c
    libtommath/mp_reduce_setup.c
    libtommath/mp_root_n.c
    libtommath/mp_rshd.c
    libtommath/mp_sbin_size.c
    libtommath/mp_set.c
    libtommath/mp_set_double.c
    libtommath/mp_set_i32.c
    libtommath/mp_set_i64.c
    libtommath/mp_set_l.c
    libtommath/mp_set_u32.c
    libtommath/mp_set_u64.c
    libtommath/mp_set_ul.c
    libtommath/mp_shrink.c
    libtommath/mp_signed_rsh.c
    libtommath/mp_sqrmod.c
    libtommath/mp_sqrt.c
    libtommath/mp_sqrtmod_prime.c
    libtommath/mp_sub.c
    libtommath/mp_sub_d.c
    libtommath/mp_submod.c
    libtommath/mp_to_radix.c
    libtommath/mp_to_sbin.c
    libtommath/mp_to_ubin.c
    libtommath/mp_ubin_size.c
    libtommath/mp_unpack.c
    libtommath/mp_warray_free.c
    libtommath/mp_xor.c
    libtommath/mp_zero.c
    libtommath/s_mp_add.c
    libtommath/s_mp_copy_digs.c
    libtommath/s_mp_div_3.c
    libtommath/s_mp_div_recursive.c
    libtommath/s_mp_div_school.c
    libtommath/s_mp_div_small.c
    libtommath/s_mp_exptmod.c
    libtommath/s_mp_exptmod_fast.c
    libtommath/s_mp_fp_log.c
    libtommath/s_mp_fp_log_d.c
    libtommath/s_mp_get_bit.c
    libtommath/s_mp_invmod.c
    libtommath/s_mp_invmod_odd.c
    libtommath/s_mp_log_2expt.c
    libtommath/s_mp_montgomery_reduce_comba.c
    libtommath/s_mp_mul.c
    libtommath/s_mp_mul_balance.c
    libtommath/s_mp_mul_comba.c
    libtommath/s_mp_mul_high.c
    libtommath/s_mp_mul_high_comba.c
    libtommath/s_mp_mul_karatsuba.c
    libtommath/s_mp_mul_toom.c
    libtommath/s_mp_prime_is_divisible.c
    libtommath/s_mp_prime_tab.c
    libtommath/s_mp_radix_map.c
    libtommath/s_mp_radix_size_overestimate.c
    libtommath/s_mp_rand_platform.c
    libtommath/s_mp_rand_source.c
    libtommath/s_mp_sqr.c
    libtommath/s_mp_sqr_comba.c
    libtommath/s_mp_sqr_karatsuba.c
    libtommath/s_mp_sqr_toom.c
    libtommath/s_mp_sub.c
    libtommath/s_mp_warray.c
    libtommath/s_mp_warray_get.c
    libtommath/s_mp_warray_put.c
    libtommath/s_mp_zero_buf.c
    libtommath/s_mp_zero_digs.c
)


target_include_directories(app PRIVATE
    libtommath
)
```

## prj.conf
```kconfig
CONFIG_DEBUG=y
CONFIG_DEBUG_OPTIMIZATIONS=y

CONFIG_MAIN_STACK_SIZE=16384
CONFIG_HEAP_MEM_POOL_SIZE=16384

CONFIG_CONSOLE_SUBSYS=y
CONFIG_CONSOLE_GETLINE=y
```

## devkit.overlay
```dts
&vregmain {
	regulator-initial-mode = <NRF5X_REG_MODE_LDO>;
};

&vregradio {
	regulator-initial-mode = <NRF5X_REG_MODE_LDO>;
};
```

## src/main.c
```c
#include <zephyr/kernel.h>
#include "tommath.h"
#include <zephyr/console/console.h>

mp_err modpow(mp_int *base, mp_int *exp, mp_int *mod, mp_int *result)
{
    mp_err rtn = mp_init_i32(result, 1);
    if (rtn != MP_OKAY)
    {
        return rtn;
    }

    while (!mp_iszero(exp)) {
        if (mp_isodd(exp)) {
            rtn = mp_mul(result, base, result);
            if (rtn != MP_OKAY)
            {
                return rtn;
            }

            rtn = mp_mod(result, mod, result);
            if (rtn != MP_OKAY)
            {
                return rtn;
            }
        }

        rtn = mp_div_2d(exp, 1, exp, NULL);
        if (rtn != MP_OKAY)
        {
            return rtn;
        }

        rtn = mp_mul(base, base, base);
        if (rtn != MP_OKAY)
        {
            return rtn;
        }
        
        rtn = mp_mod(base, mod, base);
        if (rtn != MP_OKAY)
        {
            return rtn;
        }

        k_sleep(K_MSEC(3));
    }

    return rtn;
}

int main(void)
{
    printk("Loading parameters.\n");

    mp_int n, d, c, m;
    mp_err res = mp_init(&n);
    if (res != MP_OKAY)
    {
        printk("Failed to initialise n: %d\n", res  );
        return -1;
    }

    res = mp_init(&d);
    if (res != MP_OKAY)
    {
        printk("Failed to initialise d: %d\n", res  );
        return -1;
    }

    res = mp_init(&c);
    if (res != MP_OKAY)
    {
        printk("Failed to initialise c: %d\n", res  );
        return -1;
    }

    res = mp_init(&m);
    if (res != MP_OKAY)
    {
        printk("Failed to initialise m: %d\n", res  );
        return -1;
    }

    const char* n_value = "13664239037907372261661891470992995812128631528934391124752884269617528651053943317643090937575784947507121014497497717171715238000721198283113013794512130295734489576260331261682561465391758930638013357402072021478110973654128826298049766903982395037335779141190402313347639858098129949466177493850907993591446653720099179365990534644620448650304131652280474041746240378613910471399168587342852511744545430231691608897504605714598606184911482705356693806768783646940958690855586096924000403615689800819397967604105338773209636756859376501323800107361614560297027162314856937948699650209286373343705091388728140792503";
    const char* d_value = "12198091229576740073066038428833257854167654723290760223288638390435532809404015347036163316948766320611320551034928421244963913502787642180043744328363095395760353886493288988887777263724992847353052038921650725797288287740281169149753598924538657882712509859397660670192466391473993205266013309699061174070432094598535333579917667263399538234730654655537369432047613126791256261606793368850292163333825769255762791425188947388031692719299335721791332391141486126631359462561172369363255266063706380761596896212041948116306369754039933523443196076399014502547063755298283128496407449100124937750247618124928598785593";
    const char* c_value = "7017475957803874462523966074302543158129097147429790657226279960682896591477226122698282095738274246721238318890653196205916830216637458496892522095257681715003618677124495890023843861343165641630855514175553150271337745667046395825325665199881603875814091318619655247836156484392842577721656378956876207867313374046749934094115294456504848029102891923490159831053984238123331848687881208689685500800642357139091392163908410372967220411143432404551854426595259687401994837786183518387073808919815886349474945163639093802074478297811137406107429230463524738469120697169759618786129980489550678589429921447071806277046";

    res = mp_read_radix(&n, n_value, 10);
    if (res != MP_OKAY)
    {
        printk("Failed to read n: %d\n", res);
        return -1;
    }

    res = mp_read_radix(&d, d_value, 10);
    if (res != MP_OKAY)
    {
        printk("Failed to read d: %d\n", res);
        return -1;
    }

    res = mp_read_radix(&c, c_value, 10);
    if (res != MP_OKAY)
    {
        printk("Failed to read c: %d\n", res);
        return -1;
    }

    k_sleep(K_MSEC(100));

    res = modpow(&c, &d, &n, &m);
    if (res != MP_OKAY)
    {
        printk("Failed to compute m: %d\n", res);
        return -1;
    }

    k_sleep(K_MSEC(100));

    char flag[40];

    for (int i = 0; !mp_iszero(&m); i++)
    {
        flag[i] = mp_get_i32(&m) & 0xFF;
        res = mp_div_2d(&m, 8, &m, NULL);
        if (res != MP_OKAY)
        {
            printk("Failed to shift m: %d\n", res);
            return -1;
        }

        flag[i + 1] = '\0'; // Null-terminate the string
    }
    printk("Flag loaded\n\n");

    printk("Welcome to the ultra low power flag checker!\nPlease provide flag for validation\n\n");
    
    console_getline_init();

    while (1)
    {
        printk("Flag: ");

        char* user_input = console_getline();

        if (!user_input || strcmp(user_input, flag))
        {
            printk("Wrong flag! Try again.\n");
        }
        else
        {
            printk("Correct flag! Well done!\n");
            break;
        }
    }
}
```
